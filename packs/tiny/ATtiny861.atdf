# ATtiny861 device description
Architecture: AVR8; Family: tinyAVR
Programming and debug interfaces: ISP, HVPP, debugWIRE
Registers are 8-bit, access not given, no defined reset value unless marked. A register's access mark holds for its fields unless they carry their own. Offsets are from the block's base; lines under a group give offsets from that group; [hi:lo] are bit positions; {n}, {i} and the like mark numbered series; 'fields as' and 'values as' point back to an identical list; <NAME> marks a mode.

## Ordering variants
ATtiny861V-10MU: MLF32, pinout QFN_32, up to 10 MHz, -40 to 85 C, 1.8 to 5.5 V
ATtiny861V-10PU: PDIP20, pinout SOIC_20, up to 10 MHz, -40 to 85 C, 1.8 to 5.5 V
ATtiny861V-10SU: SOIC20, pinout SOIC_20, up to 10 MHz, -40 to 85 C, 1.8 to 5.5 V
ATtiny861-20MU: MLF32, pinout QFN_32, up to 20 MHz, -40 to 85 C, 2.7 to 5.5 V
ATtiny861-20PU: PDIP20, pinout SOIC_20, up to 20 MHz, -40 to 85 C, 2.7 to 5.5 V
ATtiny861-20SU: SOIC20, pinout SOIC_20, up to 20 MHz, -40 to 85 C, 2.7 to 5.5 V

## Memory
prog space: start 0x0000 size 0x2000, little endian
  0x0000 FLASH size 0x2000 flash, rw, executable, page 0x40
signatures space: start 0 size 3, little endian
  0 SIGNATURES size 3 signatures, ro
fuses space: start 0 size 0x0003, little endian
  0 FUSES size 0x0003 fuses, rw
lockbits space: start 0 size 0x0001, little endian
  0 LOCKBITS size 0x0001 lockbits, rw
data space: start 0x0000 size 0x0260, little endian
  0x0000 REGISTERS size 0x0020 regs
  0x0020 MAPPED_IO size 0x0040 io
  0x0060 IRAM size 0x0200 ram
eeprom space: start 0x0000 size 0x0200, little endian
  0x0000 EEPROM size 0x0200 eeprom, rw, page 0x04
io space: start 0x00 size 0x40, little endian
osccal space: start 0 size 1, little endian
  0 OSCCAL size 1 osccal, ro

## Peripheral instances (address, pins/pin function, parameters)
PORTA at 0x00 — I/O Port
  pins: P{n} PA{n} (n=0..7)
PORTB at 0x00 — I/O Port
  pins: P{n} PB{n} (n=0..7)
ADC at 0x00 — Analog-to-Digital Converter
  pins: ADC0 PA0; ADC1 PA1; ADC2 PA2; ADC3 PA4; ADC4 PA5; ADC5 PA6; ADC6 PA7; ADC7 PB4; ADC8 PB5; ADC9 PB6; ADC10 PB7; AREF PA3/AREF
AC at 0x00 — Analog Comparator
  pins: AIN0 PA7/ACIN; AIN1 PA6/ACIN; AIN2 PA5/ACIN
USI at 0x00 — Universal Serial Interface
  pins: SDA PB0 or PA0/USI_ALT; SCL PB2; SCL  PA2/USI_ALT; DI PB0 or PA0/USI_ALT; DO PB1 or PA1/USI_ALT; USCK PB2 or PA2/USI_ALT
  pin routing set by: USIPOS
EEPROM at 0x00
WDT at 0x00 — Watchdog Timer
TC0 at 0x00 — Timer/Counter, 8-bit
  pins: ICP0 PA4/T0; T0 PB6/T0
TC1 at 0x00 — Timer/Counter, 16-bit
  pins: OC1AINV PB0/T1; OC1A PB1/T1; OC1BINV PB2/T1; OC1B PB3/T1; OC1DINV PB4/T1; OC1D PB5/T1
BOOT_LOAD at 0x00 — Bootloader
EXINT at 0x00 — External Interrupts
  pins: PCINT00 PA0/EXTINT; PCINT11 PA1/EXTINT; PCINT22 PA2/EXTINT; PCINT33 PA3/EXTINT; PCINT44 PA4/EXTINT; PCINT55 PA5/EXTINT; PCINT66 PA6/EXTINT; PCINT77 PA7/EXTINT; PCINT88 PB0/EXTINT; PCINT99 PB1/EXTINT; PCINT1010 PB2/EXTINT; PCINT1111 PB3/EXTINT; PCINT1212 PB4/EXTINT; PCINT1313 PB5/EXTINT; PCINT1414 PB6/EXTINT; PCINT1515 PB7/EXTINT; INT1 PA2/EXTINT; INT0 PB6/EXTINT
CPU at 0x00 — CPU Registers
FUSE at 0 in fuses — Fuses
LOCKBIT at 0 in lockbits — Lockbits

## Interrupts
0 RESET — External Reset, Power-on Reset and Watchdog Reset
1 INT0 — External Interrupt 0
2 PCINT — Pin Change Interrupt
3 TIMER1_COMPA — Timer/Counter1 Compare Match 1A
4 TIMER1_COMPB — Timer/Counter1 Compare Match 1B
5 TIMER1_OVF — Timer/Counter1 Overflow
6 TIMER0_OVF — Timer/Counter0 Overflow
7 USI_START
8 USI_OVF — USI Overflow
9 EE_RDY — EEPROM Ready
10 ANA_COMP — Analog Comparator
11 ADC — ADC Conversion Complete
12 WDT — Watchdog Time-Out
13 INT1 — External Interrupt 1
14 TIMER0_COMPA — Timer/Counter0 Compare Match A
15 TIMER0_COMPB — Timer/Counter0 Compare Match B
16 TIMER0_CAPT — ADC Conversion Complete
17 TIMER1_COMPD — Timer/Counter1 Compare Match D
18 FAULT_PROTECTION — Timer/Counter1 Fault Protection

## Properties
SIGNATURES: JTAGID=0x930D, SIGNATURE0=0x1e, SIGNATURE1=0x93, SIGNATURE2=0x0d
OCD: OCD_REVISION=1, OCD_DATAREG=0x20, PROGBASE=0x0000

## Pinouts (pin number, pad)
SOIC_20: 1 PB0, 2 PB1, 3 PB2, 4 PB3, 5 VCC, 6 GND, 7 PB4, 8 PB5, 9 PB6, 10 PB7, 11 PA7, 12 PA6, 13 PA5, 14 PA4, 15 AVCC, 16 AGND, 17 PA3, 18 PA2, 19 PA1, 20 PA0
QFN_32: 2 PB3, 4 VCC, 5 GND, 7 PB4, 8 PB5, 10 PB6, 11 PB7, 13 PA7, 14 PA6, 15 PA5, 17 PA4, 18 AVCC, 21 AGND, 22 PA3, 23 PA2, 25 PA1, 26 PA0, 30 PB0, 31 PB1, 32 PB2
