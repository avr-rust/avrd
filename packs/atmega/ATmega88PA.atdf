# ATmega88PA device description
Architecture: AVR8; Family: megaAVR
Programming and debug interfaces: ISP, HVPP, debugWIRE
Registers are 8-bit, access not given, no defined reset value unless marked. A register's access mark holds for its fields unless they carry their own. Offsets are from the block's base; lines under a group give offsets from that group; [hi:lo] are bit positions; {n}, {i} and the like mark numbered series; 'fields as' and 'values as' point back to an identical list; <NAME> marks a mode.

## Ordering variants
ATmega88PA-AU: TQFP32, up to 20 MHz, -40 to 85 C, 1.8 to 5.5 V
ATmega88PA-CCU: UFBGA32, up to 20 MHz, -40 to 85 C, 1.8 to 5.5 V
ATmega88PA-MMH: QFN28, up to 20 MHz, -40 to 85 C, 1.8 to 5.5 V
ATmega88PA-MU: QFN32, up to 20 MHz, -40 to 85 C, 1.8 to 5.5 V
ATmega88PA-PU: PDIP28, up to 20 MHz, -40 to 85 C, 1.8 to 5.5 V
ATmega88PA-AN: TQFP32, up to 20 MHz, -40 to 105 C, 1.8 to 5.5 V
ATmega88PA-MMN: QFN28, up to 20 MHz, -40 to 105 C, 1.8 to 5.5 V
ATmega88PA-MN: QFN32, up to 20 MHz, -40 to 105 C, 1.8 to 5.5 V
ATmega88PA-PN: PDIP28, up to 20 MHz, -40 to 105 C, 1.8 to 5.5 V

## Memory
prog space: start 0x0000 size 0x2000, little endian
  0x0000 FLASH size 0x2000 flash, rw, executable, page 0x40
  0x1f00 BOOT_SECTION_1 size 0x0100 flash, rw, executable, page 0x40
  0x1e00 BOOT_SECTION_2 size 0x0200 flash, rw, executable, page 0x40
  0x1c00 BOOT_SECTION_3 size 0x0400 flash, rw, executable, page 0x40
  0x1800 BOOT_SECTION_4 size 0x0800 flash, rw, executable, page 0x40
signatures space: start 0 size 3, little endian
  0 SIGNATURES size 3 signatures, ro
fuses space: start 0 size 0x0003, little endian
  0 FUSES size 0x0003 fuses, rw
lockbits space: start 0 size 0x0001, little endian
  0 LOCKBITS size 0x0001 lockbits, rw
data space: start 0x0000 size 0x0500, little endian
  0x0000 REGISTERS size 0x0020 regs
  0x0020 MAPPED_IO size 0x00e0 io
  0x0100 IRAM size 0x0400 ram
eeprom space: start 0x0000 size 0x0200, little endian
  0x0000 EEPROM size 0x0200 eeprom, rw, page 0x04
io space: start 0x00 size 0x40, little endian
osccal space: start 0 size 1, little endian
  0 OSCCAL size 1 osccal, ro

## Peripheral instances (address, pins/pin function, parameters)
USART0 at 0x00 — USART
  pins: TXD PD1; RXD PD0; XCK PD4
TWI at 0x00 — Two Wire Serial Interface
  pins: SDA PC4; SCL PC5
TC1 at 0x00 — Timer/Counter, 16-bit
  pins: T PD5; ICP PB0; OCA PB1; OCB PB2
TC2 at 0x00 — Timer/Counter, 8-bit Async
  pins: OCA PB3; OCB PD3
ADC at 0x00 — Analog-to-Digital Converter
  pins: ADC0 PC0; ADC1 PC1; ADC2 PC2; ADC3 PC3; ADC4 PC4; ADC5 PC5
AC at 0x00 — Analog Comparator
  pins: AIN0 PD6; AIN1 PD7
PORTB at 0x00 — I/O Port
  pins: P{n} PB{n} (n=0..7)
PORTC at 0x00 — I/O Port
  pins: P0 PC0; P1 PC1; P2 PC2; P3 PC3; P4 PC4; P5 PC5; P6 PC6
PORTD at 0x00 — I/O Port
  pins: P{n} PD{n} (n=0..7)
TC0 at 0x00 — Timer/Counter, 8-bit
  pins: T PD4; OCB PD5; OCA PD6
EXINT at 0x00 — External Interrupts
  pins: INT1 PD3; PCINT{n} PD{n-16} (n=16..23); PCINT{n} PB{n} (n=0..7); PCINT8 PC0; PCINT9 PC1; PCINT10 PC2; PCINT11 PC3; PCINT12 PC4; PCINT13 PC5; PCINT14 PC6; INT0 PD2
SPI at 0x00 — Serial Peripheral Interface
  pins: SS PB2; MOSI PB3; MISO PB4; SCK PB5
WDT at 0x00 — Watchdog Timer
EEPROM at 0x00
CPU at 0x00 — CPU Registers
  pins: CLK0 PB0
FUSE at 0 in fuses — Fuses
LOCKBIT at 0 in lockbits — Lockbits

## Interrupts
0 RESET — External Pin, Power-on Reset, Brown-out Reset and Watchdog Reset
1 INT0 — External Interrupt Request 0
2 INT1 — External Interrupt Request 1
3 PCINT0 — Pin Change Interrupt Request 0
4 PCINT1 — Pin Change Interrupt Request 0
5 PCINT2 — Pin Change Interrupt Request 1
6 WDT — Watchdog Time-out Interrupt
7 TIMER2_COMPA — Timer/Counter2 Compare Match A
8 TIMER2_COMPB — Timer/Counter2 Compare Match A
9 TIMER2_OVF — Timer/Counter2 Overflow
10 TIMER1_CAPT — Timer/Counter1 Capture Event
11 TIMER1_COMPA — Timer/Counter1 Compare Match A
12 TIMER1_COMPB — Timer/Counter1 Compare Match B
13 TIMER1_OVF — Timer/Counter1 Overflow
14 TIMER0_COMPA — TimerCounter0 Compare Match A
15 TIMER0_COMPB — TimerCounter0 Compare Match B
16 TIMER0_OVF — Timer/Couner0 Overflow
17 SPI_STC — SPI Serial Transfer Complete
18 USART_RX — USART Rx Complete
19 USART_UDRE — USART, Data Register Empty
20 USART_TX — USART Tx Complete
21 ADC — ADC Conversion Complete
22 EE_READY — EEPROM Ready
23 ANALOG_COMP — Analog Comparator
24 TWI — Two-wire Serial Interface
25 SPM_Ready — Store Program Memory Read

## Properties
SIGNATURES: JTAGID=0x930F, SIGNATURE0=0x1e, SIGNATURE1=0x93, SIGNATURE2=0x0f
OCD: OCD_REVISION=1, OCD_DATAREG=0x31, PROGBASE=0x0000

## Pinouts (pin number, pad)
TQFP32, QFN32: 1 PD3, 2 PD4, 3 GND, 4 VCC, 5 GND, 6 VCC, 7 PB6, 8 PB7, 9 PD5, 10 PD6, 11 PD7, 12 PB0, 13 PB1, 14 PB2, 15 PB3, 16 PB4, 17 PB5, 18 AVCC, 19 ADC6, 20 AREF, 21 GND, 22 ADC7, 23 PC0, 24 PC1, 25 PC2, 26 PC3, 27 PC4, 28 PC5, 29 PC6, 30 PD0, 31 PD1, 32 PD2
QFN28: 1 PD3, 2 PD4, 3 VCC, 4 GND, 5 PB6, 6 PB7, 7 PD5, 8 PD6, 9 PD7, 10 PB0, 11 PB1, 12 PB2, 13 PB3, 14 PB4, 15 PB5, 16 AVCC, 17 AREF, 18 GND, 19 PC0, 20 PC1, 21 PC2, 22 PC3, 23 PC4, 24 PC5, 25 PC6, 26 PD0, 27 PD1, 28 PD2
PDIP28: 1 PC6, 2 PD0, 3 PD1, 4 PD2, 5 PD3, 6 PD4, 7 VCC, 8 GND, 9 PB6, 10 PB7, 11 PD5, 12 PD6, 13 PD7, 14 PB0, 15 PB1, 16 PB2, 17 PB3, 18 PB4, 19 PB5, 20 AVCC, 21 AREF, 22 GND, 23 PC0, 24 PC1, 25 PC2, 26 PC3, 27 PC4, 28 PC5
UFBGA32: B1 PD3, B2 PD4, C1 GND, D1 VDD, C1 GND, D2 VDD, E1 PB6, F1 PB7, F2 PD5, E2 PD6, F3 PD7, E3 PB0, F4 PB1, E4 PB2, F5 PB3, F6 PB4, E6 PB5, E5 AVCC, D6 ADC6, D5 AREF, C6 GND, C5 ADC7, B6 PC0, A6 PC1, A5 PC2, B5 PC3, A4 PC4, B4 PC5, A3 PC6, B3 PD0, A2 PD1, A1 PD2
